// SPDX-License-Identifier: BSD-3-Clause
#include <dt-bindings/firmware/qcom,scm.h>

/dts-v1/;
/plugin/;

&scm {
	qcom,shm-bridge-vmid = <QCOM_SCM_VMID_HLOS>;
	qcom,qseecom-client-id = <QCOM_SCM_VMID_HLOS>;
};
